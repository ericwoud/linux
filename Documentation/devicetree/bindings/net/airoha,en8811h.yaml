## Documentation/devicetree/bindings/net/airoha,en8811h.yaml
```yaml
# SPDX-License-Identifier: (GPL-2.0-only OR BSD-2-Clause)
%YAML 1.2
---
$id: http://devicetree.org/schemas/net/airoha,en8811h.yaml#
$schema: http://devicetree.org/meta-schemas/core.yaml#

title: Airoha EN8811H PHY

maintainers:
  - Eric Woudstra <ericwouds@gmail.com>

description:
  The Airoha EN8811H PHY has the ability to reverse polarity
  on the lines to and/or from the MAC. It is reversed by
  the booleans in the devicetree node of the phy.
  Extra device is pointed to by phandle. Address on the mdio
  bus is always the phy address + 8.

allOf:
  - $ref: ethernet-phy.yaml#

properties:
  compatible:
    enum:
      - ethernet-phy-id03a2.a411

  reg:
    maxItems: 1

  airoha,pnswap-rx:
    type: boolean
    description:
      Reverse rx polarity of the SERDES. This is the receiving
      side of the lines from the MAC towards the EN881H.

  airoha,pnswap-tx:
    type: boolean
    description:
      Reverse tx polarity of SERDES. This is the transmitting
      side of the lines from EN8811H towards the MAC.

  airoha,extradev-handle:
    $ref: /schemas/types.yaml#/definitions/phandle
    description:
      Phandle to the en8811h extra device.

required:
  - reg

unevaluatedProperties: false

examples:
  - |
    mdio {
        #address-cells = <1>;
        #size-cells = <0>;

        ethernet-phy@1 {
            compatible = "ethernet-phy-id03a2.a411";
            reg = <1>;
            airoha,pnswap-rx;
            airoha,extradev-handle = <&en8811h_extradev9>;
        };

        /* phy address + 8 */
        en8811h_extradev9: en8811h-extradev@9 {
            compatible = "airoha,en8811h-extradev";
            reg = <9>;
        };

    };
```
